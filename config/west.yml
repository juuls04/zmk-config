## config/west.yml
```yaml
manifest:
  remotes:
    - name: zmkfirmware
      url-base: https://github.com/DiogoDoreto
  projects:
    - name: zmk
      remote: DiogoDoreto
      revision: main
      import: app/west.yml
  self:
    path: config
```
